## drivers/iommu/loongson/Kconfig
```kconfig
# SPDX-License-Identifier: GPL-2.0-only
# Loongson IOMMU support
config LOONGSON_IOMMU
	bool "Loongson IOMMU support"
	select IOMMU_API
	select IOMMU_DMA
	select IOMMU_DEFAULT_PASSTHROUGH
	depends on LOONGARCH
	help
	  With this option you can enable support for Loongson IOMMU hardware in
	  your system. An IOMMU is a hardware component which provides remapping
	  of DMA memory accesses from devices. With an IOMMU you can isolate the
	  DMA memory of different devices and protect the system from misbehaving
	  device drivers or hardware.
```
